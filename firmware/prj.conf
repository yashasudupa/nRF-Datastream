## CMakeLists.txt
```
cmake_minimum_required(VERSION 3.20.0)
find_package(Zephyr REQUIRED HINTS $ENV{ZEPHYR_BASE})
project(nrf_ble_fw C)

set(CMAKE_C_STANDARD 11)
set(CMAKE_C_EXTENSIONS ON)

target_sources(app PRIVATE
  src/main.c
  services/gatt_service.c
  drivers/imu_lsm6dsv32x.c
)

target_include_directories(app PRIVATE
  ${CMAKE_CURRENT_SOURCE_DIR}/include
  ${CMAKE_CURRENT_SOURCE_DIR}/services
  ${CMAKE_CURRENT_SOURCE_DIR}/drivers
)
```

## prj.conf
```kconfig
# --- BLE peripheral basics ---
CONFIG_BT=y
CONFIG_BT_PERIPHERAL=y
CONFIG_BT_DEVICE_NAME="NRF-BLE-DEMO"
CONFIG_BT_DEVICE_APPEARANCE=0
CONFIG_BT_GATT_DYNAMIC_DB=y
CONFIG_BT_GATT_NOTIFY_MULTIPLE=y

# GAP/GATT niceties
CONFIG_BT_PRIVACY=y
CONFIG_BT_SMP=y
CONFIG_BT_SECURE_CONN=y
CONFIG_BT_MAX_CONN=1
CONFIG_BT_MAX_PAIRED=1

# Buffers (safe defaults; tweak later)
CONFIG_BT_BUF_ACL_TX_COUNT=10
CONFIG_BT_BUF_ACL_RX_COUNT=10
CONFIG_BT_L2CAP_TX_MTU=247
CONFIG_BT_GATT_CLIENT=n

# --- Logging / shell (optional) ---
CONFIG_LOG=y
CONFIG_LOG_MODE_DEFERRED=y
CONFIG_CONSOLE=y

# --- I2C + sensor (even if our IMU driver is stubbed) ---
CONFIG_I2C=y
CONFIG_SENSOR=y

# ST IMU driver
CONFIG_LSM6DSV32X=y
CONFIG_LSM6DSV32X_TRIGGER_NONE=y    # simplest polling mode
CONFIG_LSM6DSV32X_ACCEL_RANGE_32G=y
CONFIG_LSM6DSV32X_GYRO_RANGE_2000DPS=y

# --- Flash + settings (if you later store bonds etc.) ---
CONFIG_FLASH=y
CONFIG_SETTINGS=y
CONFIG_BT_SETTINGS=y
```

## boards/nrf54l15dk.overlay
```dts
/* Applies when you build for -b nrf54l15dk/nrf54l15 */

&i2c0 {
    status = "okay";
    clock-frequency = <I2C_BITRATE_FAST>;
    /* Pins use board defaults; override here if you wire a discrete IMU */
};

/* If later you mount an LSM6… on i2c0 at 0x6A, you can add a node like:
&i2c0 {
    lsm6@6a {
        compatible = "st,lsm6dsl";  /* placeholder if you switch to a Zephyr-supported variant */
        reg = <0x6a>;
        status = "okay";
    };
};
*/
```

## src/main.c
```c
#include <zephyr/kernel.h>
#include <zephyr/bluetooth/bluetooth.h>
#include <zephyr/bluetooth/hci.h>
#include <string.h>
#include "app_config.h"
#include "gatt_service.h"
#include "imu_lsm6dsv32x.h"

static void on_rx(const uint8_t *data, size_t len)
{
  /* Example: echo command 0x01 -> send one IMU sample */
  if (len >= 1 && data[0] == 0x01) {
    int16_t ax, ay, az, gx, gy, gz;
    if (imu_read_raw(&ax, &ay, &az, &gx, &gy, &gz) == 0) {
      uint8_t pkt[1 + 12];
      pkt[0] = 0x10; // sample opcode
      memcpy(&pkt[1], &ax, 2); memcpy(&pkt[3], &ay, 2); memcpy(&pkt[5], &az, 2);
      memcpy(&pkt[7], &gx, 2); memcpy(&pkt[9], &gy, 2); memcpy(&pkt[11], &gz, 2);
      gatt_send_notify(pkt, sizeof(pkt));
    }
  }
}

void main(void)
{
  int err;

  err = bt_enable(NULL);
  if (err) { return; }

  gatt_service_init(on_rx);
  imu_init();

  struct bt_le_adv_param advp = {
    .options = BT_LE_ADV_OPT_CONNECTABLE,
    .id = BT_ID_DEFAULT,
    .interval_min = BT_GAP_ADV_FAST_INT_MIN_2,
    .interval_max = BT_GAP_ADV_FAST_INT_MAX_2,
  };

  const char dev_name[] = APP_DEVICE_NAME;
  bt_le_adv_start(&advp,
    (struct bt_data []) {
      BT_DATA_BYTES(BT_DATA_FLAGS, (BT_LE_AD_GENERAL | BT_LE_AD_NO_BREDR)),
      BT_DATA(BT_DATA_NAME_COMPLETE, dev_name, sizeof(dev_name) - 1)
    }, 2,
    NULL, 0);

  while (1) {
    k_sleep(K_SECONDS(1));
    /* Periodic notify demo: 0x20 heartbeat */
    uint8_t hb[2] = {0x20, 0x01};
    gatt_send_notify(hb, sizeof(hb));
  }
}
```

## include/app_config.h
```c
#pragma once

/* App config knobs */
#define APP_DEVICE_NAME       "NRF-BLE-DEMO"
#define APP_ADV_INT_MIN_MS    100
#define APP_ADV_INT_MAX_MS    150
#define APP_NOTIFY_MTU        180   // keep <= negotiated MTU-3
```

## include/gatt_service.h
```c
#pragma once
#include <stddef.h>
#include <stdint.h>

typedef void (*rx_handler_t)(const uint8_t *data, size_t len);

int gatt_service_init(rx_handler_t on_rx);
int gatt_send_notify(const uint8_t *data, size_t len);
```
